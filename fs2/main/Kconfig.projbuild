## fs2/main/Kconfig.projbuild
```kconfig
menu "Knob Control Settings"
    config KNOB_WIFI_SSID
        string "WiFi SSID"
        default ""
        help
            Empty string = USB-HID-only mode (no WiFi, no WebSocket).

    config KNOB_WIFI_PASSWORD
        string "WiFi Password"
        default ""
        depends on KNOB_WIFI_SSID

    config KNOB_WEBSOCKET_URI
        string "WebSocket URI"
        default "ws://10.10.10.2:8765"

    config KNOB_ENCODER_STEP
        int "Encoder step size (ticks per unit)"
        default 3

    config KNOB_BACKLIGHT_DEFAULT
        int "Default backlight brightness (0-255)"
        default 200
endmenu
```

## fs2/sdkconfig.defaults
```kconfig
CONFIG_IDF_TARGET="esp32s3"

# Flash
CONFIG_ESPTOOLPY_FLASHSIZE_16MB=y
CONFIG_ESPTOOLPY_FLASHMODE_QIO=y
CONFIG_ESPTOOLPY_FLASHFREQ_80M=y

# PSRAM
CONFIG_ESP32S3_SPIRAM_SUPPORT=y
CONFIG_SPIRAM_MODE_OCT=y
CONFIG_SPIRAM_SPEED_80M=y

# Partition table
CONFIG_PARTITION_TABLE_CUSTOM=y
CONFIG_PARTITION_TABLE_CUSTOM_FILENAME="partitions.csv"

# TinyUSB
CONFIG_TINYUSB=y
CONFIG_TINYUSB_HID=y
CONFIG_TINYUSB_DESC_MANUFACTURER_STRING="KnobControl"
CONFIG_TINYUSB_DESC_PRODUCT_STRING="Smart Knob Controller"

# LVGL
CONFIG_LV_COLOR_DEPTH_16=y
CONFIG_LV_FONT_MONTSERRAT_14=y
CONFIG_LV_FONT_MONTSERRAT_20=y
CONFIG_LV_FONT_MONTSERRAT_28=y
CONFIG_LV_USE_PERF_MONITOR=n

# FreeRTOS
CONFIG_FREERTOS_HZ=1000

# FAT Filesystem
CONFIG_FATFS_LONG_FILENAME_SUPPORT=y
CONFIG_VFS_LONG_NAMESUPPORT=y

# USB CDC (for logging alongside HID)
CONFIG_USB_CDC_ON_BOOT=y

# Compiler
CONFIG_COMPILER_OPTIMIZATION_PERF=y

# Log level
CONFIG_LOG_DEFAULT_LEVEL_INFO=y
```
